/dts-v1/;
/plugin/;

/ {
    compatible = "brcm,bcm2835";

    fragment@0 {
        target-path = "/";
        __overlay__ {
            plat_drv: plat_drv@0 {
              compatible = "au-ece,plat_drv";
              gpios = <&gpio 16 0>, <&gpio 21 1>;
              gpio-directions = <0 1>; // 0=input, 1=output
              status = "okay";
          };
        };
    };
};
